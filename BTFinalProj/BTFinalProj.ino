/*
4:35,BLUE,Rosemont,O'Hare 15,O'Hare 20
*/
#include <LiquidCrystal.h>
#include <Time.h>
//Initialize LCD 
const int rs = 12, en = 11, d4 = 8, d5 = 7, d6 = 6, d7 = 5;
LiquidCrystal lcd(rs, en, d4, d5, d6, d7);
bool stringEntered = false;
String userString = "\0";
char convBuffer[80];
char buffer[200];
char stringBuffer[200];
char * direction;
char * station;

const int outputPin = 1;
int hr;
char min[3];

void parseString(String s)
{
  char tempBuffer[100];
  //Convert string to char array
  int i;
  for(i = 0; i < s.length(); i++)
  {
    convBuffer[i] = s[i];
  }
  
  char * time = strtok(convBuffer, ",");
  direction = strtok(NULL, ",");
  station = strtok(NULL, ",");
  
  char * remString = strtok(NULL,",");
  char * remString2 = strtok(NULL,"\0");
  
  remString2[strlen(remString2)-1] = '\0';
  strcpy(tempBuffer, remString);
  strcat(tempBuffer, ",");
  strcat(tempBuffer,remString2);
  tempBuffer[strlen(tempBuffer)] = '\0';
  Serial.println(tempBuffer);
  //digitalWrite(tempBuffer);
//Testing Time printouts
  char* strHour = strtok(time, ":");
  hr = atoi(strHour);
  
  time = strtok(NULL, " ");
  char * strMin = strtok(time, ",");
  
  
  strcpy(min,strMin);
  
  stringEntered = true;
}


void setup() {
    Serial.begin(9600); //Begin serial communication
    
    // Initialize output button
    pinMode(outputPin, OUTPUT);
    
    //Initialize LCD
    lcd.begin(16,2);
    
    //Initialize LCD Cursor
    lcd.cursor(); 
    
    
    
    //setTime(t);
}

void loop() {
  int i;
  
  for(i = 0; i < 200; i++){
    stringBuffer[i] = '\0';
  }
  while(!stringEntered){
     int userBytes = 0;
     userBytes = Serial.readBytes(buffer,200);
      if(userBytes != 0){
          //Serial.println(userBytes); 
          sprintf(stringBuffer, buffer);
         // Serial.println(stringBuffer);
         }
         
      if(strlen(stringBuffer) != 0){
        parseString(stringBuffer);
      }   
     
      //userString = Serial.readString();
      
      //if(userString != "\0"){
      //  parseString(userString);
      //}
      
    }
  
  lcd.clear();
  lcd.setCursor(0,0);
  //time_t t = now();
  //setTime(t);
  lcd.print(hr);
  lcd.print(":");
  lcd.print(min);
  lcd.print(" ");
  lcd.print(direction);
  //lcd.print(second(t));
  lcd.setCursor(0,1);
  lcd.print(station);
  lcd.setCursor(0,0);
  
  stringEntered = false;
}
