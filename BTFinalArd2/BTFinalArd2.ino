/*
 Arduino 2 
 Outputs the first 2 trains arriving and their times
*/



#include <LiquidCrystal.h>
#include <Time.h>
//Initialize LCD 
const int rs = 12, en = 11, d4 = 8, d5 = 7, d6 = 6, d7 = 5;
LiquidCrystal lcd(rs, en, d4, d5, d6, d7);
const int inputPin = 0;
bool stringEntered = false;
String userString = "\0";
char convBuffer[80];
char buffer[201];
char stringBuffer[200];
char * arrival1;
char * arrival2;

void parseString(String s)
{
  //O'Hare 15, O'Hare 20,4
  //Convert string to char array
  int i;
  for(i = 0; i < s.length(); i++)
  {
    convBuffer[i] = s[i];
  }
  convBuffer[i] = '\0';
  arrival1 = strtok(convBuffer, ",");
  Serial.println(arrival1);
  arrival2 = strtok(NULL, ",");

  char * buzzStr = strtok(NULL, " ");
  Serial.println(arrival2);
  //arrival2[strlen(arrival2) - 2] = '\0';

  buzzStr[strlen(buzzStr) - 1] = '\0';
  
  //Serial.println(arrival2);
  Serial.println(buzzStr);
  stringEntered = true;
}


void setup() {
    Serial.begin(9600); //Begin serial communication
    
    //Initialize LCD
    lcd.begin(16,2);
    
    //Initialize LCD Cursor
    lcd.cursor(); 
    
    pinMode(inputPin, INPUT);
    
    //setTime(t);
}

void loop() {
  int i;
  for(i = 0; i < 200; i++){
    stringBuffer[i] = '\0';
  }
  
  while(!stringEntered){
     
     
     //char * newString = "\0";
     //int userBytes = 0;
      userString = Serial.readString();
      //userBytes = Serial.readBytes(buffer,200);
      //if(userBytes != 0){
      //  Serial.println(userBytes); 
      //  sprintf(stringBuffer, buffer);
      //  Serial.println(stringBuffer);
         
      //}
      
      if(userString != "\0"){
        parseString(userString);
      }
      //if(strlen(stringBuffer) != 0){
      //  parseString(stringBuffer);
      //}
      
    }
  
  lcd.clear();
  lcd.setCursor(0,0);
  lcd.print(arrival1);
  lcd.setCursor(0,1);
  lcd.print(arrival2);
  
  
  stringEntered = false;
}
